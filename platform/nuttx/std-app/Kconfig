## platform/nuttx/std-app/Kconfig
```kconfig
config EXAMPLES_RUSTCAM_STD_APP
	bool "Rustcam ordinary Rust std application"
	default n
	depends on BUILD_FLAT && !DISABLE_PTHREAD
```

## tests/nuttx-std/nuttx/Kconfig
```kconfig
config EXAMPLES_NXRS_STD
	bool "Nxrs ordinary Rust main/std qualification"
	default n
	depends on BUILD_FLAT && !DISABLE_PTHREAD
```
